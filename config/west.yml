## config/west.yml
```yaml
manifest:
  remotes:
    - name: HgGamer
      url-base: https://github.com/HgGamer
  projects:
    - name: zmk
      remote: HgGamer
      revision: main
      import: app/west.yml
  self:
    path: config
```
